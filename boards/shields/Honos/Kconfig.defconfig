## boards/shields/Honos/Kconfig.defconfig
```kconfig
if SHIELD_HONOS_LEFT

config ZMK_KEYBOARD_NAME
    default "Honos"

config ZMK_SPLIT_ROLE_CENTRAL
    default y

endif

if SHIELD_HONOS_LEFT || SHIELD_HONOS_RIGHT

config ZMK_SPLIT
    default y


endif
```

## boards/shields/Honos/Kconfig.shield
```kconfig
config SHIELD_HONOS_LEFT
    def_bool $(shields_list_contains,Honos_left)

config SHIELD_HONOS_RIGHT
    def_bool $(shields_list_contains,Honos_right)
```
